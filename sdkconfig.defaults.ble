## sdkconfig.defaults.ble
```kconfig
# BLE 配网变体专用配置（bread-compact-wifi-ble）
CONFIG_BOARD_TYPE_BREAD_COMPACT_WIFI=y
CONFIG_OLED_SSD1306_128X32=y
CONFIG_USE_HOTSPOT_WIFI_PROVISIONING=n
CONFIG_USE_SIMPLE_BLE_PROVISIONING=y

# ── BLE 控制器（ESP32-S3 仅支持 BLE，不支持 Classic BT）──────
CONFIG_BT_ENABLED=y
CONFIG_BT_CONTROLLER_ENABLED=y
CONFIG_BT_LE_ENABLED=y
CONFIG_BT_CTRL_MODE_BLE_ONLY=y

# ── NimBLE 主机 ───────────────────────────────────────────────
CONFIG_BT_NIMBLE_ENABLED=y
CONFIG_BT_NIMBLE_ROLE_PERIPHERAL=y
CONFIG_BT_NIMBLE_ROLE_BROADCASTER=y

# ── WiFi + BLE 共存（必须，否则 ble_controller_init 失败）────
CONFIG_ESP_COEX_ENABLED=y
CONFIG_SW_COEXIST_ENABLE=y

# 自定义唤醒词（小鹿小鹿）
CONFIG_USE_CUSTOM_WAKE_WORD=y
CONFIG_CUSTOM_WAKE_WORD="xiao lu xiao lu"
CONFIG_CUSTOM_WAKE_WORD_DISPLAY="小鹿小鹿"
CONFIG_CUSTOM_WAKE_WORD_THRESHOLD=20
CONFIG_SR_MN_CN_MULTINET7_QUANT=y
```
